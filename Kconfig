## Kconfig
```kconfig
# Smart Tag application configuration.

menu "Smart Tag"

config SMART_TAG_FLASH_JEDEC_ID
	bool
	default y
	depends on DT_HAS_JEDEC_SPI_NOR_ENABLED
	select FLASH_JESD216_API
	help
	  Whether this board has an external flash whose JEDEC ID can be read
	  at bring-up. True on the HOLyiot board; false on the nRF54L15 Tag,
	  whose MX25R6435F footprint is not populated (BOM U8 = Not Fitted) and
	  whose logs live in internal RRAM instead.

	  Driven by the devicetree and set here rather than in
	  boards/<board>.conf on purpose. Zephyr only applies a board .conf
	  when CONF_FILE is left undefined (see configuration_files.cmake), so
	  a perfectly reasonable-looking "-DCONF_FILE=prj.conf" would silently
	  drop it and the build would fail at link with an undefined
	  z_impl_flash_read_jedec_id. This file is always sourced.

config SMART_TAG_HW_VALIDATION
	bool "Build the hardware validation firmware"
	help
	  Replaces the product application with a standalone peripheral test
	  runner (src/validation/hw_validation.c).

	  The validation build deliberately talks to the SPI and I2C parts
	  through raw register access rather than the Zephyr sensor drivers.
	  A driver that refuses to bind reports one error for several possible
	  causes - wrong chip select, wrong part fitted, dead bus - whereas a
	  raw WHO_AM_I read on each chip select says which.

	  Set by prj_validation.conf rather than by hand:

	      west build -b holyiot_25025/nrf54l15/cpuapp -p always .
	          -- -DCONF_FILE=prj_validation.conf

config SMART_TAG_HW_VALIDATION_DESTRUCTIVE
	bool "Include the destructive external flash test"
	depends on SMART_TAG_HW_VALIDATION
	default y
	help
	  Erases and rewrites the first sector of the event log partition to
	  prove the external NOR can be written, not just identified. Turn off
	  to leave the flash contents untouched.

config SMART_TAG_BLE_ADVERTISE_AT_BOOT
	bool "Open the BLE service window automatically at boot"
	help
	  Normally BLE only advertises when the button opens a service window
	  (PLAN.md section 11) - see ble_manager.c. Set this to open that same
	  window automatically once at boot instead, so BLE can be verified
	  (e.g. with nRF Connect) without needing to press the physical
	  button. It is the real service window, not a separate always-on
	  mode: it still closes itself after ble_service_window_s like any
	  other service window, and a button press still extends or reopens
	  it as normal.

	  Production prj.conf leaves this off. Enable it with
	  -DEXTRA_CONF_FILE=prj_debug.conf for bring-up.

config SMART_TAG_HAS_GAS
	bool
	default y
	depends on DT_HAS_BOSCH_BME680_ENABLED
	help
	  Board has a gas sensor (BME688 on the nRF54L15 Tag). Compile-time
	  capability; runtime validity is still SENSOR_VALID_GAS.

config SMART_TAG_HAS_6AXIS_IMU
	bool
	default y
	depends on DT_HAS_BOSCH_BMI270_ENABLED
	help
	  Board has a 6-axis IMU (BMI270). Read only while moving.

config SMART_TAG_HAS_MOTION_WAKE
	bool
	default y
	depends on DT_HAS_ADI_ADXL367_ENABLED
	help
	  Board can wake the sampling thread from an accelerometer interrupt
	  (ADXL367 INT1 on P0). Holyiot LIS2DH INT lands on P2 and cannot.

endmenu

# Local out-of-tree drivers (see drivers/CMakeLists.txt and drivers/Kconfig).
rsource "drivers/Kconfig"

source "Kconfig.zephyr"
```

## boards/holyiot/holyiot_25025/Kconfig.defconfig
```kconfig
# SPDX-License-Identifier: Apache-2.0

config HW_STACK_PROTECTION
	default ARCH_HAS_STACK_PROTECTION

if BOARD_HOLYIOT_25025_NRF54L15_CPUAPP

config ROM_START_OFFSET
	default 0x800 if BOOTLOADER_MCUBOOT

endif # BOARD_HOLYIOT_25025_NRF54L15_CPUAPP
```

## boards/holyiot/holyiot_25025/Kconfig.holyiot_25025
```kconfig
# SPDX-License-Identifier: Apache-2.0

config BOARD_HOLYIOT_25025
	select SOC_NRF54L15_CPUAPP if BOARD_HOLYIOT_25025_NRF54L15_CPUAPP
```

## boards/holyiot/holyiot_25025/board.yml
```yaml
board:
  name: holyiot_25025
  full_name: HOLyiot 25025 Beacon V1.0 (nRF54L15 Smart Tag)
  vendor: holyiot
  socs:
    - name: nrf54l15
runners:
  run_once:
    '--recover':
      - runners:
          - nrfjprog
          - nrfutil
        run: first
        groups:
          - boards:
              - holyiot_25025/nrf54l15/cpuapp
    '--erase':
      - runners:
          - nrfjprog
          - jlink
          - nrfutil
        run: first
        groups:
          - boards:
              - holyiot_25025/nrf54l15/cpuapp
    '--reset':
      - runners:
          - nrfjprog
          - jlink
          - nrfutil
        run: last
        groups:
          - boards:
              - holyiot_25025/nrf54l15/cpuapp
```

## drivers/Kconfig
```kconfig
# Local out-of-tree drivers.
#
# SPDX-License-Identifier: Apache-2.0

rsource "sensor/lps22hb_spi/Kconfig"
```

## drivers/sensor/lps22hb_spi/Kconfig
```kconfig
# HOLyiot LPS22HB pressure sensor (SPI), local out-of-tree driver.
#
# Copyright (c) 2026 HOLyiot
# SPDX-License-Identifier: Apache-2.0

config LPS22HB_SPI
	bool "LPS22HB pressure sensor (SPI, local driver)"
	default y
	depends on DT_HAS_HOLYIOT_LPS22HB_ENABLED
	depends on SENSOR
	select SPI
	help
	  Local driver for the LPS22HB pressure sensor over SPI. Exists
	  because Zephyr's in-tree "st,lps22hh" driver refuses to bind to a
	  real LPS22HB (WHO_AM_I 0xB1) - see the top-level README's
	  LPS22HB/LPS22HH note. The register layout is otherwise compatible,
	  so this driver reuses the same CTRL_REG1/PRESS_OUT sequence, just
	  without the strict ID check.
```

## dts/bindings/sensor/holyiot,lps22hb.yaml
```yaml
# Copyright (c) 2026 HOLyiot
# SPDX-License-Identifier: Apache-2.0

description: |
  LPS22HB pressure sensor connected over SPI.

  Only SENSOR_CHAN_PRESS is implemented - the part also has a TEMP_OUT
  register, but nothing on this board needs it (the SHT40 is the temperature
  source), so the driver never reads it.

  Register-compatible with ST's LPS22HH - same CTRL_REG1 ODR/BDU bits, same
  24-bit PRESS_OUT registers, auto-increment always on for burst reads -
  but Zephyr's in-tree "st,lps22hh" driver hard-rejects this part's real
  WHO_AM_I (0xB1, not 0xB3) and refuses to bind. See the top-level README's
  LPS22HB/LPS22HH note. drivers/sensor/lps22hb_spi is a small local driver
  that accepts either ID and otherwise follows the same sequence.

compatible: "holyiot,lps22hb"

include: ["spi-device.yaml", "sensor-device.yaml"]
```
